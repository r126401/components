## comunes/Kconfig.projbuild
```kconfig
menu "Configuracion de inicializacion"

config FACTORY_DATA
	bool "Carga de configuracion de fabrica"
	default false
	help
		 indica carga desde memoria nvs mientras que 1 indica de fabrica. 


config UINT32_FORMAT
	string "Cadena para el formato de ESP_LOG cuando se formatea un long"
	default "%ld"
	help
		Define la cadena que se pone	
	
config LONG_FORMAT
	string "Cadena para el formato de ESP_LOG cuando se formatea un long"
	default "%lld"
	help
		Define la cadena que se pone	
		
config ULONG_FORMAT
	string "Cadena para el formato de ESP_LOG cuando se formatea un long"
	default "%llu"
	help
		Define la cadena que se pone	
		



endmenu
```

## conexiones/Kconfig.projbuild
```kconfig
menu "Configuracion General"
	
config DEFAULT_SCAN_LIST_SIZE
	int "Size scan list wifi"
	default 10
	help
		Define size scan list wifi
		

config UINT32_FORMAT
	string "Cadena para el formato de ESP_LOG cuando se formatea un long"
	default "%ld"
	help
		Define la cadena que se pone	
	
config LONG_FORMAT
	string "Cadena para el formato de ESP_LOG cuando se formatea un long"
	default "%lld"
	help
		Define la cadena que se pone	
		



endmenu
```

## configuracion/Kconfig.projbuild
```kconfig
menu "Configuracion General components"


config WIFI_ACTIVE
	bool "Activar la configuracion wifi"
	default false
	help
		Indica si la aplicacion va a utilizar el servicio wifi
		
config CLOCK_ACTIVE
	depends on WIFI_ACTIVE
	bool "Activar la configuracion ntp"
	default false
	help
		Indica si la aplicacion va a utilizar el servicio ntp

config SCHEDULE_ACTIVE
	depends on CLOCK_ACTIVE
	bool "Activar la configuracion de schedules"
	default false
	help
		Indica si la aplicacion va a utilizar el servicio schedule

config MQTT_ACTIVE
	depends on WIFI_ACTIVE
	bool "Activar la configuracion mqtt"
	default false
	help
		Indica si la aplicacion va a utilizar el servicio mqtt





config FACTORY_DATA
	bool "Forzar carga de configuracion de fabrica"
	default false
	help
		 indica carga desde memoria nvs mientras que 1 indica de fabrica. 



menu "Configuracion nvs"

config CLAVE_CONFIGURACION_GENERAL
	string "Clave nvs para configuracion general"
	default "general"
	help
		Clave nvs para extraer la configuracion general

config CLAVE_PROGRAMACION
	string "Clave nvs para cargar la programacion de los dispositivos"
	default "programacion"
	help
		Clave nvs para cargar la programacion de los dispositivos

config CLAVE_PROGRAMA_ESTATICO
	string "Clave nvs para cargar el programa activo cuando arrancas de 0"
	default "programa_estatico_real"
	help
		Clave nvs para cargar el programa activo cuando arrancas de 0
		

config CLAVE_CERTIFICADO_TLS
	string "Clave nvs para cargar el certificado tls"
	default "cert_tls"
	help
		Clave nvs para cargar el certificado tls
		
		
config NAMESPACE
	string "Espacio de nombre configuracion"
	default "CONF_DISP"
	help
		Espacio de nombres nvs usado para la configuracion general.

endmenu

menu "Configuraciones mqtt"

config BROKER_DEFECTO
	string "Broker Mqtt"
	default "mqtt://jajicaiot.ddns.net"
	help
		Servidor Mqtt
		
config PUERTO_DEFECTO
	int "Puerto Mqtt"
	default 1883
	help
		Puerto Mqtt
		
config USUARIO_BROKER_DEFECTO
	string "Usuario broker"
	default ""
	help
		Usuario de acceso al servidor Mqtt

config PASSWORD_BROKER_DEFECTO
	string "Password broker"
	default ""
	help
		Password de acceso al servidor Mqtt

config MQTT_TLS
        bool "habilita conexion segura"
        default false
        help
            Habilita conexion segura para el servidor mqtt.
	
config PREFIJO_SUSCRIPCION_DEFECTO
	string "prefijo para los topics usados"
	default "/"
	help
		Los topics de suscripcion y publicacion tendran este prefijo
		
config TAMANO_BUFFER_LECTURA
	int "Tamano del buffer de lectura"
	default 1024
	help
		Es el tamano de buffer para leer datos en nvs y enviarlos por mqtt
		
config NUM_TOPICS
	int "Topics de la aplicacion"
	default 3
	help 
		Indica los topics a gestionar por el dispositivo

endmenu

menu "logging format"

config UINT32_FORMAT
	string "Cadena para el formato de ESP_LOG cuando se formatea un uint32_t"
	default "%ld"
	help
		Define la cadena que se pone	
	
config LONG_FORMAT
	string "Cadena para el formato de ESP_LOG cuando se formatea un long"
	default "%lld"
	help
		Define la cadena que se pone	
		
config ULONG_FORMAT
	string "Cadena para el formato de ESP_LOG cuando se formatea un usigned long"
	default "%llu"
	help
		Define la cadena que se pone	
		
endmenu




	
menu "Wifi Configurations"


config DEFAULT_SCAN_LIST_SIZE
	int "Size scan list wifi"
	default 10
	help
		Define size scan list wifi


endmenu

menu "NTP Configurations"

config TIMEOUT_NTP
	int "tiempo espera peticion ntp"
	default 5000
	help
		Es el tiempo de espera a que el servidor ntp responda

config SERVIDOR_NTP
	string "Servidor ntp"
	default "pool.ntp.org"
	help
		Es el servidor ntp usado en la aplicacion.

endmenu

menu "Task Configurations"

config RESOURCE_EVENT_TASK
	int "memory event task"
	default 4096
	help 
		Indica la memoria de la tarea event_task

config RESOURCE_MQTT_TASK
	int "memory mqtt task"
	default 8192
	help 
		Indica la memoria de la tarea mqtt_task

config RESOURCE_SMARTCONFIG_TASK
	int "memory smartconfig task"
	default 4096
	help 
		Indica la memoria de la tarea smartconfig_task


config RESOURCE_OTA_TASK
	int "memory ota task"
	default 4096
	help 
		Indica la memoria de la tarea ota_task

config RESOURCE_APP_TASK
	int "memory app task"
	default 4096
	help 
		Indica la memoria de la tarea app_task
endmenu


endmenu
```

## ds18x20/Kconfig.projbuild
```kconfig
menu "Configuracion ds18b20"
	
config GPIO_PIN_DS18B20
    int "PIN SENSOR DS18B20"
    default 0
    help 
        Implement pin gpio to sensor DS18B20

endmenu
```

## espressif__esp_lcd_touch_gt911/Kconfig.projbuild
```kconfig
menu "GT911 CONFIGURATION"
    config TOUCH_GT911_SDA
        int "pin SDA to touch"
        default 19
        help
            Pin sda to i2c

    config TOUCH_GT911_SCL
        int "pin SCL to touch"
        default 20
        help
            Pin sda to i2c

    config TOUCH_GT911_CLOCK_HZ
        int "Frecuency the device"
        default 400
        help
            is the frecuency to the device noted in Khz
endmenu
```

## interfaz_usuario/Kconfig.projbuild
```kconfig
menu "Configuracion Termostato"

config TIPO_DISPOSITIVO
	int "Tipo de dispositivo"
	default 0
	help
		indica el tipo de dispositivo

config GPIO_PIN_RELE
	int "Pin gipo para activar el rele"
	default 12
	help 
		Indica el pin gpio con el que se activa el rele



endmenu
```
